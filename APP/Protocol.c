#include "Protocol.h"
#include "Tasks.h"
#include <stdio.h>
#include <stdlib.h>
extern float duoji,light_c;
extern uint16_t depth_c,angle_c,forward_c,side_c,direct_c,direct_c1,direct_c2,duoji_c;
extern uint16_t ok,start;

float THROTTLE,depth_E,direction,pump;
uint8_t key_Value[4];
uint8_t turn_l,turn_r; 
float depth_balance;
extern float shendu_actual,temp;

enum mode {DEEP_DIRECTION_KEEPING_NAVIGATION=1, DEEP_KEEPING_NAVIGATION, DIRECTION_KEEPING_NAVIGATION, MANUAL} ;
enum mode WORKMODE; //workmode

extern volatile uint8_t Rx_Buffer1[26],Rx_Buffer3[20];//data from uart1 and uart2
extern uint16_t lightt;
/****************************************************************************************************
Fuction Prototype : 	void Depthgauge_Get(void) 
Features          :   Get depth and temputre
Parameter         :
******************************************************************************************************/ 
//54 3D 2D 32 37 2E 39 35 |44 3D 2D 30 2E 30 31 0D  data T=-xx.xxD=-x.xx
// 0  1  2  3  4  5  6  7 | 8  9 10 11 12 13 14 15  byte
//54 3D 2D 32 37 2E 39 35 |44 3D 30 2E 30 31 0D  data    T=-xx.xxD=xx.xx
// 0  1  2  3  4  5  6  7 | 8  9 10 11 12 13 14  byte

void Depthgauge_Get()
{
	//first find 'D'and'\r'
	int posD=0 ,posR=0;
	
	for (int i=7;i<18;i++)
	{
			if(Rx_Buffer3[i]== 'D') posD=i;
			if(Rx_Buffer3[i]== '\r') posR=i;
	}
	
	char tempbuf[posD-2],depthbuf[posR-posD-2];
	//temp value is from Rx_Buffer3[2] to Rx_Buffer3[posD-1] and our operating temperature is -99 to 99 
	for(int i=2;i<posD;i++)
	{
			tempbuf[i-2]=Rx_Buffer3[i];
	}
	
	for(int i=posD+2;i<posR;i++)
	{
			depthbuf[i-posD-2]=Rx_Buffer3[i];
	}
	
	temp=atof(tempbuf);
	shendu_actual=atof(depthbuf);
	//depth value is from Rx_Buffer3[posD+2] to Rx_Buffer3[posR-1] and operating depth is -9.99m to 99.99m
	
	
	


}



/******************************************************************************
函数原型：	CRC-16/MODBUS
功    能：	校验
参    数：  pack：数据包  num：包长
*******************************************************************************/ 

//=================================================================================================
// CRC High
//------------------
unsigned char const CRC_H[] = {
0x00, 0xC1, 0x81, 0x40, 0x01, 0xC0, 0x80, 0x41, 0x01, 0xC0,
0x80, 0x41, 0x00, 0xC1, 0x81, 0x40, 0x01, 0xC0, 0x80, 0x41,
0x00, 0xC1, 0x81, 0x40, 0x00, 0xC1, 0x81, 0x40, 0x01, 0xC0,
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0x80, 0x41, 0x00, 0xC1, 0x81, 0x40
} ;
//=================================================================================================
// CRC Low
//----------------
unsigned char const CRC_L[] = {
0x00, 0xC0, 0xC1, 0x01, 0xC3, 0x03, 0x02, 0xC2, 0xC6, 0x06,
0x07, 0xC7, 0x05, 0xC5, 0xC4, 0x04, 0xCC, 0x0C, 0x0D, 0xCD,
0x0F, 0xCF, 0xCE, 0x0E, 0x0A, 0xCA, 0xCB, 0x0B, 0xC9, 0x09,
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0x43, 0x83, 0x41, 0x81, 0x80, 0x40
} ;



unsigned short do_crc(u8 *pack, int num)
{
	unsigned char CRCcode_H = 0XFF;		// CRC High Init
  unsigned char CRCcode_L = 0XFF;		// CRC Low Init
  unsigned char index,i=0;			// index
  while (num--) {
        index = CRCcode_L ^ (pack[i++]);
        CRCcode_L = CRCcode_H ^ CRC_H[index];
        CRCcode_H = CRC_L[index];
    }
    return (CRCcode_L << 8 | CRCcode_H);	// MODBUS  
};







//		depth_E   = (((Rx_Buffer1[3])<<8)|(Rx_Buffer1[4]))*1.0/1000*2.4414;
//	    direction = (((Rx_Buffer1[5])<<8)|(Rx_Buffer1[6]))*0.044-90;
//        THROTTLE  = (((Rx_Buffer1[7])<<8)|(Rx_Buffer1[8]))*0.244+1000;
//	    pump      =  Rx_Buffer1[12];

u16 set;
/******************************************************************************
函数原型：	void Order_Get(void) 
功    能：	得到ROV控制指令
参    数：  无
*******************************************************************************/ 
void Order_Get(void)  
{
	unsigned short check=0;
	u8 depth_flag=0;
	
	check|=Rx_Buffer1[22];
	check=check<<8;
	Depthgauge_Get();

	if(do_crc(Rx_Buffer1,22)==(check|Rx_Buffer1[23]))//数据校验
	{ 
		
		forward_c=(uint16_t)(Rx_Buffer1[14]);
		side_c   =(uint16_t)(Rx_Buffer1[15]);
		depth_c  =(uint16_t)(Rx_Buffer1[16]);
		
		
		if((Rx_Buffer1[3]&0x07) == 0)         //engine stop
		{
			start=0;
		}
		
//		if((Rx_Buffer1[3]&0x07) == 1 )         //deep direction keeping navigation
//		{
//			WORKMODE=DEEP_DIRECTION_KEEPING_NAVIGATION;
//			if(depth_flag == 0) 
//			{
//				depth_balance = shendu_actual;
//			  depth_flag ++ ;
//				
//			}
//			start=1;
//		}
//		else if((Rx_Buffer1[3]&0x07) == 2 )    //deep keeping navigation
//		{
//			WORKMODE=DEEP_KEEPING_NAVIGATION;
//			if(depth_flag == 0)    //set the depth at begining and lock the value
//			{
//				depth_balance = shendu_actual;
//			  depth_flag ++ ;
//				
//			}
//			start=1;
//		}
//    else if((Rx_Buffer1[3]&0x07) == 3 )     //direction navigation
//		{
//			WORKMODE=DIRECTION_KEEPING_NAVIGATION;
//			depth_flag = 0;
//			start=1;
//			
//		}
//		else if ((Rx_Buffer1[3]&0x07) == 4)     //manual
//		{
//			WORKMODE=MANUAL;
//			depth_flag = 0;
//			start=1;
//		}
		else   start=1;  //engine start
		
		
    if(Rx_Buffer1[3]>>7 )      //light on
		{
		   TIM2->CCR1 = 1400;	
		}
		
		 else  TIM2->CCR1 = 0;	
		
		 
		if(((Rx_Buffer1[3]>>3)&0x03) == 1)      //arm on
		{
		   TIM2->CCR2 = 1600;	
		}
		else if (((Rx_Buffer1[3]>>3)&0x03) == 0)      //arm stop
		{
		   TIM2->CCR2 = 1500;	
		}
	else  TIM2->CCR2 = 1100;	//arm off
	
		
		
		
		
	   /* direction = (((Rx_Buffer1[5])<<8)|(Rx_Buffer1[6]));     //方向
		if(direction<1800)
			 direction=0.2778*direction-500;
		else  if(direction>2300)
		           direction=0.2778*direction-639;  
		      else
				   direction=0; 
		
        THROTTLE  = (((Rx_Buffer1[7])<<8)|(Rx_Buffer1[8]));
		if(THROTTLE<1800)
			 THROTTLE=0.2778*THROTTLE+1000;

		else  if(THROTTLE>2300)
		           THROTTLE=0.2778*THROTTLE+861;  
		      else
				   THROTTLE=1500; 
		
	    pump  =  Rx_Buffer1[12];*/
	}


}

